## tbk_mini/Kconfig.defconfig
```kconfig
if SHIELD_CORNE_LEFT

config ZMK_KEYBOARD_NAME
	default "TBK Mini"

config ZMK_SPLIT_BLE_ROLE_CENTRAL
	default y

endif

if SHIELD_CORNE_LEFT || SHIELD_CORNE_RIGHT

config ZMK_SPLIT
	default y

endif
```

## tbk_mini/Kconfig.shield
```kconfig
config SHIELD_TBK_MINI_LEFT
	def_bool $(shields_list_contains,tbk_mini_left)

config SHIELD_CORNE_RIGHT
	def_bool $(shields_list_contains,tbk_mini_left)
```
